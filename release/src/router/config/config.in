## release/src/router/config/config.in
```kconfig
mainmenu "FreshTomato Configuration"

config TCONFIG_OPTIMIZE_SHARED_LIBS
	bool "Optimize shared libraries (remove unused symbols)"
	default y

config TCONFIG_MIPSR2
	bool "MIPS R2 flag"
	default n

config TCONFIG_L2TP
	bool "L2TP"
	default y

config TCONFIG_PPTP
	bool "PPTP"
	default y

config TCONFIG_PPTPD
	bool "PPTPD"
	depends on TCONFIG_PPTP
	default n

config TCONFIG_MULTIWAN
	bool "MultiWAN support"
	default n

config TCONFIG_HTTPS
	bool "HTTPS"
	default y

config TCONFIG_SSH
	bool "SSH"
	default y

config TCONFIG_CIFS
	bool "CIFS Client"
	default y

config TCONFIG_BRCM_NAND_JFFS2
	bool "JFFS Support on BRCM Nand Flash Partition"
	default n

config TCONFIG_JFFS2
	bool "JFFS Support"
	default y

config TCONFIG_JFFSV1
	bool "  Use JFFSv1 (if not selected, JFFS2 is used)"
	depends on TCONFIG_JFFS2
	default y

config TCONFIG_ZEBRA
	bool "Zebra"
	default y

config TCONFIG_DDNS
	bool "Dynamic DNS"
	default y

config TCONFIG_L7
	bool "Layer 7 Netfilter"
	default y

config TCONFIG_L7PAT
	bool "  Standard Layer 7 Patterns"
	depends on TCONFIG_L7
	default y

config TCONFIG_LZO
	bool "LZO Compression"
	default n

config TCONFIG_OPENVPN
	bool "OpenVPN"
	depends on TCONFIG_LZO
	default n

# !!TB
config TCONFIG_IPV6
	bool "IPv6 Support"
	default n

config TCONFIG_EBTABLES
	bool "Ebtables"
	default n

config TCONFIG_EMF
	bool "Broadcom EMF (Efficient Multicast Forwarding & IGMP Snooping)"
	default n

config TCONFIG_USB
	bool "USB Support"
	default y

config TCONFIG_NOCAT
	bool "NoCat Splash"
	default n

config TCONFIG_NGINX
	bool "NGinX Web Server"
	default n

config TCONFIG_MEDIA_SERVER
	bool "Media Server (MiniDLNA)"
	depends on TCONFIG_USB
	default n

config TCONFIG_FTP
	bool "  FTP Server"
	depends on TCONFIG_USB
	default y

config TCONFIG_FTP_SSL
	bool "    FTP SSL Support"
	depends on TCONFIG_FTP
	default n

config TCONFIG_SAMBASRV
	bool "  Samba File Sharing"
	depends on TCONFIG_USB
	default y

config TCONFIG_USB_EXTRAS
	bool "  Additional modules and utilities"
	depends on TCONFIG_USB
	default n

config TCONFIG_NTFS
	bool "  NTFS-3g Support"
	depends on TCONFIG_USB
	default n

config TCONFIG_BT
	bool "  Bittorrent client gui only"
	default n

config TCONFIG_BBT
	bool "  Bittorrent client binaries only"
	default n

config TCONFIG_TR_EXTRAS
	bool "  Transmission extra tools"
	default n
	depends on TCONFIG_BT

config TCONFIG_NFS
	bool "  NFS Server"
	default n

config TCONFIG_SNMP
	bool "  SNMP"
	default n

config TCONFIG_SDHC
	bool "  SDHC/MMC mod for WRT54G/GL"
	default n

config TCONFIG_HFS
	bool "  HFS/HFS+ filesystem support "
	default n

config TCONFIG_UPS
	bool "  UPS Monitor"
	depends on TCONFIG_USB
	default n

config TCONFIG_NANO
	bool "  NANO - user-friendly file editor"
	default n

config TCONFIG_DNSCRYPT
	bool "  DNScrypt-proxy"
	default n

config TCONFIG_STUBBY
	bool "  Stubby - DNS-over-TLS resolver"
	default n

config TCONFIG_TOR
	bool "  TOR Project"
	default n

config TCONFIG_IPSEC
	bool "IPSec Support"
	default n

config TCONFIG_RAID
	bool "RAID Support: mdadm plus md modules"
	default n

config TCONFIG_AIO
	bool "Flag to detect AIO target"
	default n

config TCONFIG_CTF
	bool "CTF (Cut-Through Forwarding)"
	default n

config TCONFIG_BCMNAT
	bool "Broadcom FastNAT (bcm_nat)"
	default n

config TCONFIG_DNSSEC
	bool "DNSSEC"
	default n

config TCONFIG_TINC
	bool "TINC"
	default n

config TCONFIG_OPENSSL11
	bool "OpenSSL 1.1.x"
	default n

config TCONFIG_IPERF
	bool "IP Bandwidth monitoring utility"
	default n

config TCONFIG_KEYGEN
	bool "TLS keys generator in GUI for VPN Server"
	default n

config TCONFIG_TERMLIB
	bool "Termlib based tools-shell.asp"
	default n

config TCONFIG_ADVTHEMES
	bool "Advanced Themes similar to AdvancedTomato"
	default n

config TCONFIG_NVRAM_32K
	bool "NVRAM_32K"
	default n

config TCONFIG_OPTIMIZE_SIZE
	bool "Flag to detect small targets used for size optimization"
	default y

config TCONFIG_OPTIMIZE_SIZE_MORE
	bool "Flag to optimize code even more"
	default n
```
